## security/cgbpf/Kconfig
```kconfig
# SPDX-License-Identifier: GPL-2.0-only
config SECURITY_CGBPF
	bool "cgroup LSM-BPF support"
	depends on SECURITY
	default y
	help
	  This select cgroup LSM-BPF support.

	  If you are unsure how to answer this question, answer N.
```

## security/dummy/Kconfig
```kconfig
# SPDX-License-Identifier: GPL-2.0-only
config SECURITY_DUMMY
	bool "dummy LSM that does nothing but return 0"
	depends on SECURITY
	default y
	help
	  This for evaluation purposes only.

	  If you are unsure how to answer this question, answer N.
```
